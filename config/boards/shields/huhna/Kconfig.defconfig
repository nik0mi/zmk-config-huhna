## config/boards/shields/huhna/Kconfig.defconfig
```kconfig
if SHIELD_HUHNA_DONGLE

config ZMK_KEYBOARD_NAME
    default "Huhna"

config ZMK_SPLIT_ROLE_CENTRAL
    default y

config ZMK_SPLIT
    default y

config ZMK_SPLIT_BLE_CENTRAL_PERIPHERALS
    default 2

config BT_MAX_CONN
    default 4

config BT_MAX_PAIRED
    default 4

endif

if SHIELD_HUHNA_LEFT || SHIELD_HUHNA_RIGHT

config ZMK_SPLIT
    default y
    
endif
```

## config/boards/shields/huhna/Kconfig.shield
```kconfig
config SHIELD_HUHNA_LEFT
    def_bool $(shields_list_contains,huhna_left)

config SHIELD_HUHNA_RIGHT
    def_bool $(shields_list_contains,huhna_right)

config SHIELD_HUHNA_DONGLE
    def_bool $(shields_list_contains,huhna_dongle)
```
