#include "huhna.dtsi"

/ {
    chosen {
        zmk,kscan = &mock_kscan;
        zmk,matrix_transform = &default_transform;
    };

    mock_kscan: mock_kscan {
        compatible = "zmk,kscan-mock";
        label = "MOCK_KSCAN";
        columns = <12>;
        rows = <4>;
    };
};
